/*
 * Project Name: NOKIA5110_TEXT
 * File: main.c
 * Description: Nokia library example test file  , runs a series of tests to test library.
 * Author: Gavin Lyons.
 * URL: https://github.com/gavinlyonsrepo/pic_16F1619_projects
 */

#include "mcc_generated_files/mcc.h"
#include "NOKIA5110_TEXT.h"

#define inverse  false
#define contrast 0xBF // default is 0xBF set in LCDinit, Try 0xB1 to 0xBF if your display is too dark
#define bias 0x13 // LCD bias mode 1:48: Try 0x12 or 0x13 or 0x14
#define TEST_DELAY 2000

    // 'image1', snake game, 84x48px
    const unsigned char mybitmap[504] = {
        0x00, 0x00, 0x00, 0x00, 0x00, 0x00, 0x00, 0x00, 0x00, 0x80, 0xc0, 0xe0, 0xf0, 0xf8, 0xf8, 0x7c,
        0x7c, 0x20, 0x00, 0xe0, 0xe0, 0xf0, 0xf0, 0xf0, 0x80, 0x00, 0x00, 0xe0, 0xf8, 0xf8, 0xfc, 0x38,
        0x00, 0xe0, 0xf0, 0xf8, 0xf8, 0xf8, 0xf8, 0x80, 0x00, 0x10, 0x78, 0x7c, 0xfc, 0xfc, 0x00, 0x80,
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        0x00, 0x00, 0x00, 0x00, 0x00, 0x00, 0x00, 0x00
    };

    // 'image2', lighting bolts,  84x24px
    const unsigned char mybitmap2[252] = {
        0xff, 0xff, 0xff, 0xff, 0xff, 0xff, 0xff, 0xff, 0xff, 0xff, 0xff, 0xff, 0xff, 0xff, 0xff, 0xff,
        0x7f, 0x7f, 0x3f, 0x3f, 0x1f, 0x0f, 0x0f, 0x07, 0x87, 0xc3, 0xe3, 0xf9, 0xfd, 0xff, 0xff, 0xff,
        0xff, 0xff, 0xff, 0xff, 0xff, 0xff, 0xff, 0xff, 0xff, 0xff, 0xff, 0xff, 0xff, 0xff, 0xff, 0xff,
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        0xff, 0xff, 0xff, 0xff, 0xff, 0xff, 0xff, 0xff, 0xff, 0xff, 0xff, 0xff
    };
    

void TestLoop(void); 
void TestTwoLoop(void); 
void TestThreeLoop(void); 
void TestFourLoop(void); 
void Setup(void); // setup the pic

/* --------- Main application --------------- */
void main(void) {
    Setup();
    while (1) {
        __delay_ms(TEST_DELAY);
        // General tests, default font , clear and fill , 
        // draw, custom char
        TestLoop();
        // For testing fonts 1-6  Comment in  defines at 
        // top of  NOKIA5110_TEXT.h if using non default
        TestTwoLoop();
        // for testing fonts 7-9
        TestThreeLoop();
        // bitmap test
        TestFourLoop();
    }
}
// --------- end of main --------------

// Function Space

//****************************** TEST LOOP ONE ****************************
// Text and  function tests
void TestLoop(void) {
    /* TESTS
     1. TEST 1a writing text to blocks
     2. TEST 1b clearing by  blocks
     3. TEST 1c sleep mode
     4. TEST 1d Draw some pixel
     5. TEST 1e Draw a horizontal line with SetPixel across screen at row 10
     6. TEST 1f Draw a vertical line in block 2 of one byte at column 3
     7. TEST 1g Fill Screen
     8. TEST 1h Fill block
     9. TEST 1i Custom Character
     */
    
    //Custom Characters for  TEST 1i Custom Character
    const unsigned char power[12] = {0xff, 0xe7, 0xc3, 0x99, 0xa5, 0xad, 0xad, 0xa5, 0x99, 0xc3, 0xe7, 0xff}; //power icon
    const unsigned char myspeed[12] = {0xff, 0xff, 0xf7, 0xb3, 0xd1, 0xc0, 0xe0, 0xf4, 0xf6, 0xfe, 0xff, 0xff}; //lighting symbol
    
    bool drawtext = true; //enable  TEST 1a
    bool clearline = true; //enable  TEST 1b
    bool sleepmodetest = true; // enable TEST 1c
    bool pixeltest = true; // enable TEST d e f
    
    //TEST 1a writing text to blocks
    if (drawtext == true) {
        __delay_ms(TEST_DELAY);
        LCDgotoXY(0, 0); // (go to (X , Y) (0-84 columns, 0-5 blocks)
        LCDString("Block 0"); //print to block 0 (0-5 blocks or row bytes)
        __delay_ms(TEST_DELAY);
        LCDgotoXY(2, 1);
        LCDString("Block 1"); //print to block 1 indented by two
        __delay_ms(TEST_DELAY);
        LCDgotoXY(4, 2);
        LCDString("Block 2"); //print to block 2   indented by four
        __delay_ms(TEST_DELAY);
        LCDgotoXY(6, 3);
        LCDString("Block 3"); //print to block 3  indented by six
        __delay_ms(TEST_DELAY);
        LCDgotoXY(8, 4);
        LCDString("Block 4"); //print to block 4 indented by 8 col
        __delay_ms(TEST_DELAY);
        LCDgotoXY(10, 5);
        LCDString("Block 5"); //print to block 5 indented by 10 col
        __delay_ms(TEST_DELAY);
    }


    // TEST 1b clearing by  blocks
    if (clearline == true) {
        LCDClearBlock(0); //clear line/block 0
        __delay_ms(TEST_DELAY);
        LCDClearBlock(5); //clear line/block 5
        __delay_ms(TEST_DELAY);
    }

    //TEST 1c sleep mode
    if (sleepmodetest == true) {
        LCDClear(0x00);
        LCDgotoXY(0, 0);
        LCDString("Sleep 10s");
        __delay_ms(1000);
        LCDenableSleep(); //go to sleep
        __delay_ms(10000);
        LCDdisableSleep(); //wake up
        LCDgotoXY(0, 0);
        LCDString("Awake");
        __delay_ms(TEST_DELAY);
    }

    // Test 1d Pixels
     if (pixeltest == true) {
        LCDClear(0x00);

        LCDgotoXY(0, 5); // (go to (X , Y) (0-84 columns, 0-5 blocks)
        LCDString("Draw Pixels"); 
        __delay_ms(TEST_DELAY);

        for (uint8_t Pixels = 11; Pixels < 255; Pixels++) {
            LCDSetPixel(Pixels / 5, Pixels / 10);
            __delay_ms(25);
        }

        // 1e Draw a horizontal line with SetPixel across screen at row 10 
        LCDClear(0x00);
        LCDgotoXY(0, 0); // (go to (X , Y) (0-84 columns, 0-5 blocks)
        LCDString("Draw Lines"); //print to block 0 (0-5 blocks or row bytes)
        __delay_ms(TEST_DELAY);

        for (uint8_t col = 3; col < 71; col++) {
            LCDSetPixel(col, 23);
            LCDSetPixel(col, 31);
        }
        __delay_ms(TEST_DELAY);

        // 1f Draw a vertical line in block 2 of one byte at column 3  
        LCDgotoXY(3, 3);
        LCDWrite(LCD_DATA, 0xFF);
        LCDgotoXY(70, 3);
        LCDWrite(LCD_DATA, 0xFF);
        __delay_ms(TEST_DELAY);
    }
    // TEST 1g Fill whole with Screen with pattern
    LCDClear(0x00);
    LCDgotoXY(0, 0);
    LCDString("Fill Screen");
    __delay_ms(TEST_DELAY);

    LCDClear(0xBA); //  pattern 0b10111010
    __delay_ms(TEST_DELAY);

    // Test 1h fill block
    LCDClear(0X00);
    LCDgotoXY(0, 0);
    LCDString("Fill block");
    __delay_ms(TEST_DELAY);
    LCDFillBlock(0xAB, 4); //  0b10101011
    __delay_ms(TEST_DELAY);


    //Test 1i Custom characters
    LCDClear(0X00);
    LCDgotoXY(0, 0);
    LCDString("Custom char");
    LCDgotoXY(40, 2);
    LCDCustomChar(power, sizeof (power) / sizeof (unsigned char), 0x03);
    LCDgotoXY(40, 4);
    LCDCustomChar(myspeed, sizeof (myspeed) / sizeof (unsigned char), 0x03);
    __delay_ms(5000);

    //whole screen clear again
    LCDClear(0x00);
    __delay_ms(TEST_DELAY);
}

//****************************** TEST LOOP TWO ****************************
// fonts 1-6 tests,  NOTE fonts  must be  commented in header file 

void TestTwoLoop() {
    

    __delay_ms(TEST_DELAY);
    LCDFont(LCDFont_Default); //font 1
    LCDgotoXY(0, 0); // (go to (X , Y) (0-84 columns, 0-5 blocks)
    LCDString("1234567890AB"); //print to block 0 
    __delay_ms(TEST_DELAY);
    LCDFont( LCDFont_Thick); // font 2 
    LCDgotoXY(0, 1);
    LCDString("VOLTAGE 2"); //print to block 1
    __delay_ms(TEST_DELAY);
    LCDFont(LCDFont_HomeSpun); //font 3
    LCDgotoXY(0, 2);
    LCDString("ABCD 1234"); //print to block 2
    __delay_ms(TEST_DELAY);
    LCDFont(LCDFont_Seven_Seg); //font 4
    LCDgotoXY(0, 3);
    LCDString("VOLTAGE 5.843"); //print to block 3
    __delay_ms(TEST_DELAY);
    LCDFont(LCDFont_Wide); //font 5
    LCDgotoXY(0, 4);
    LCDString("VOLTAGE"); //print to block 4
    __delay_ms(TEST_DELAY);
    LCDFont(LCDFont_Tiny); //font 6
    LCDgotoXY(0, 5); // (go to (X , Y) (0-84 columns, 0-5 blocks)
    LCDString("1234567890123456"); //print to block 5
    __delay_ms(TEST_DELAY);
    LCDFont(LCDFont_Default);
    LCDClear(0x00);
}

//****************************** TEST LOOP THREE ****************************
// fonts 7-9 tests,  Note  fonts  must be  commented in header file 

void TestThreeLoop() {
    // ***** TEST 3a font 7 large 12 * 16 *********
    // :NO LOWER CASE LETTERS for  font 7
    LCDClear(0X00); //clear whole screen
    LCDFont(LCDFont_Large); //font 7
    LCDgotoXY(20, 1);
    LCDString("TIME");
    LCDgotoXY(15, 3); // this font takes two blocks
    LCDString("23:04");
    __delay_ms(5000);


    // ***** TEST 3b font 8 huge 16 * 24 *********
    // NUMBERS  only + : . /
    LCDClear(0x00);
    LCDFont(LCDFont_Huge); // font 8 this font takes 3 blocks
    LCDgotoXY(0, 0);
    LCDString("10:39");
    LCDgotoXY(0, 3);
    LCDString("4.288");
    __delay_ms(5000);
    
    // ********** TEST 3c font 9 MEGA font 16 * 32 *********
    //  NUMBERS  only + : . /
    LCDClear(0x00);
    LCDFont(LCDFont_Mega); // font 8 this font takes 4 blocks
    LCDgotoXY(0, 1);
    LCDString("14.23");
    __delay_ms(5000);

}

//****************************** TEST LOOP four****************************
// bitmap tests,  Note  fonts  must be  commented in header file 

void TestFourLoop() {

    LCDClear(0x00); // Clear whole screen
    LCDFont(LCDFont_Default); // Set the font
    LCDgotoXY(0, 0); // (go to (X , Y) (0-84 columns, 0-5 blocks) top left corner
    LCDString("BITMAP TEST"); //print
    __delay_ms(2000);

    // Test half size bitmap  252 bytes
    LCDgotoXY(0, 0);
    LCDCustomChar(mybitmap2, sizeof (mybitmap2) / sizeof (unsigned char), 0x00);
    LCDgotoXY(0, 4);
    LCDString("Error : 1202");
    __delay_ms(5000);
    LCDClear(0x00);

    //Test full size bitmap 504 bytes
    LCDCustomChar(mybitmap, sizeof (mybitmap) / sizeof (unsigned char), 0x00);
    __delay_ms(5000);
    LCDClear(0x00);
}


// Setup PIC

void Setup(void) {
    SYSTEM_Initialize();
    LCDInit(inverse, contrast, bias); // init the lCD
    LCDClear(0x00); // Clear whole screen
    LCDFont(LCDFont_Default); 
}
/* ------------- End of File -----------  */